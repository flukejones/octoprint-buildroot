## configs/stm32mp157c_dk2_defconfig
```kconfig
BR2_arm=y
BR2_cortex_a7=y
BR2_OPTIMIZE_3=y
# BR2_COMPILER_PARANOID_UNSAFE_PATH is not set
BR2_SSP_NONE=y
BR2_RELRO_NONE=y
BR2_FORTIFY_SOURCE_NONE=y
BR2_TOOLCHAIN_BUILDROOT_GLIBC=y
BR2_GCC_VERSION_11_X=y
BR2_TOOLCHAIN_BUILDROOT_CXX=y
BR2_GCC_ENABLE_LTO=y
BR2_GCC_ENABLE_GRAPHITE=y
BR2_TARGET_OPTIMIZATION="-fpic -feliminate-dwarf2-dups -funroll-loops -fomit-frame-pointer -frename-registers"
BR2_ROOTFS_DEVICE_CREATION_DYNAMIC_MDEV=y
BR2_ROOTFS_OVERLAY="$(BR2_EXTERNAL_OCTOPRINT_PATH)/board/common/overlay/ $(BR2_EXTERNAL_OCTOPRINT_PATH)/board/stm32mp157c-dk2/overlay/"
BR2_ROOTFS_POST_IMAGE_SCRIPT="board/stmicroelectronics/common/stm32mp157/post-image.sh"
BR2_LINUX_KERNEL=y
BR2_LINUX_KERNEL_USE_CUSTOM_CONFIG=y
BR2_LINUX_KERNEL_CUSTOM_CONFIG_FILE="$(BR2_EXTERNAL_OCTOPRINT_PATH)/board/stm32mp157c-dk2/linux.config"
BR2_LINUX_KERNEL_DTS_SUPPORT=y
BR2_LINUX_KERNEL_INTREE_DTS_NAME="stm32mp157c-dk2"
BR2_LINUX_KERNEL_INSTALL_TARGET=y
BR2_PACKAGE_BUSYBOX_WATCHDOG=y
BR2_PACKAGE_BUSYBOX_WATCHDOG_PERIOD="15"
BR2_PACKAGE_GETTEXT=y
BR2_PACKAGE_MMC_UTILS=y
BR2_PACKAGE_MTD=y
BR2_PACKAGE_DEJAVU=y
BR2_PACKAGE_MESA3D=y
BR2_PACKAGE_MESA3D_GALLIUM_DRIVER_ETNAVIV=y
BR2_PACKAGE_MESA3D_OPENGL_EGL=y
BR2_PACKAGE_MESA3D_OPENGL_ES=y
BR2_PACKAGE_LIBUBOOTENV=y
BR2_PACKAGE_UBOOT_TOOLS=y
BR2_PACKAGE_PYTHON3=y
BR2_PACKAGE_PYTHON_PIP=y
BR2_PACKAGE_CA_CERTIFICATES=y
BR2_PACKAGE_LIBSHA1=y
BR2_PACKAGE_LIBOPENSSL_BIN=y
BR2_PACKAGE_LIBOPENSSL_ENGINES=y
BR2_PACKAGE_LIBCONFIG=y
BR2_PACKAGE_LIBPCIACCESS=y
BR2_PACKAGE_TSLIB=y
BR2_PACKAGE_ELFUTILS=y
BR2_PACKAGE_LINUX_PAM=y
BR2_PACKAGE_IW=y
BR2_PACKAGE_OPENSSH=y
BR2_PACKAGE_WIRELESS_TOOLS=y
BR2_PACKAGE_WIRELESS_TOOLS_LIB=y
BR2_PACKAGE_WPA_SUPPLICANT=y
BR2_PACKAGE_WPA_SUPPLICANT_CLI=y
BR2_TARGET_ROOTFS_EXT2=y
BR2_TARGET_ROOTFS_EXT2_4=y
BR2_TARGET_ROOTFS_EXT2_SIZE="200M"
# BR2_TARGET_ROOTFS_TAR is not set
BR2_TARGET_ARM_TRUSTED_FIRMWARE=y
BR2_TARGET_ARM_TRUSTED_FIRMWARE_CUSTOM_VERSION=y
BR2_TARGET_ARM_TRUSTED_FIRMWARE_CUSTOM_VERSION_VALUE="v2.5"
BR2_TARGET_ARM_TRUSTED_FIRMWARE_PLATFORM="stm32mp1"
BR2_TARGET_ARM_TRUSTED_FIRMWARE_ADDITIONAL_VARIABLES="STM32MP_SDMMC=1 AARCH32_SP=sp_min DTB_FILE_NAME=stm32mp157c-dk2.dtb"
BR2_TARGET_ARM_TRUSTED_FIRMWARE_IMAGES="*.stm32"
BR2_TARGET_ARM_TRUSTED_FIRMWARE_NEEDS_DTC=y
BR2_TARGET_UBOOT=y
BR2_TARGET_UBOOT_BUILD_SYSTEM_KCONFIG=y
BR2_TARGET_UBOOT_CUSTOM_VERSION=y
BR2_TARGET_UBOOT_CUSTOM_VERSION_VALUE="2021.10"
BR2_TARGET_UBOOT_BOARD_DEFCONFIG="stm32mp15_trusted"
BR2_TARGET_UBOOT_NEEDS_OPENSSL=y
# BR2_TARGET_UBOOT_FORMAT_BIN is not set
BR2_TARGET_UBOOT_FORMAT_STM32=y
BR2_TARGET_UBOOT_CUSTOM_MAKEOPTS="DEVICE_TREE=stm32mp157c-dk2"
BR2_PACKAGE_HOST_GENIMAGE=y
BR2_PACKAGE_PYTHON_OCTOPRINT=y
```

## package/Config.in
```kconfig
source "$BR2_EXTERNAL_OCTOPRINT_PATH/package/python-blinker/Config.in"
source "$BR2_EXTERNAL_OCTOPRINT_PATH/package/python-cachelib/Config.in"
source "$BR2_EXTERNAL_OCTOPRINT_PATH/package/python-click_8_0/Config.in"
source "$BR2_EXTERNAL_OCTOPRINT_PATH/package/python-colorlog_6_4/Config.in"
source "$BR2_EXTERNAL_OCTOPRINT_PATH/package/python-emoji/Config.in"
source "$BR2_EXTERNAL_OCTOPRINT_PATH/package/python-feedparser/Config.in"
source "$BR2_EXTERNAL_OCTOPRINT_PATH/package/python-filetype/Config.in"
source "$BR2_EXTERNAL_OCTOPRINT_PATH/package/python-flask-assets/Config.in"
source "$BR2_EXTERNAL_OCTOPRINT_PATH/package/python-flask-limiter/Config.in"
source "$BR2_EXTERNAL_OCTOPRINT_PATH/package/python-frozendict/Config.in"
source "$BR2_EXTERNAL_OCTOPRINT_PATH/package/python-octoprint/Config.in"
source "$BR2_EXTERNAL_OCTOPRINT_PATH/package/python-octoprint-filecheck/Config.in"
source "$BR2_EXTERNAL_OCTOPRINT_PATH/package/python-octoprint-firmwarecheck/Config.in"
source "$BR2_EXTERNAL_OCTOPRINT_PATH/package/python-octoprint-pisupport/Config.in"
source "$BR2_EXTERNAL_OCTOPRINT_PATH/package/python-ordered-set/Config.in"
source "$BR2_EXTERNAL_OCTOPRINT_PATH/package/python-pkginfo/Config.in"
source "$BR2_EXTERNAL_OCTOPRINT_PATH/package/python-pyserial/Config.in"
source "$BR2_EXTERNAL_OCTOPRINT_PATH/package/python-pyyaml_5_4/Config.in"
source "$BR2_EXTERNAL_OCTOPRINT_PATH/package/python-rich/Config.in"
source "$BR2_EXTERNAL_OCTOPRINT_PATH/package/python-sarge/Config.in"
source "$BR2_EXTERNAL_OCTOPRINT_PATH/package/python-sentry-sdk_1_5/Config.in"
source "$BR2_EXTERNAL_OCTOPRINT_PATH/package/python-semantic-version_2_8/Config.in"
source "$BR2_EXTERNAL_OCTOPRINT_PATH/package/python-unidecode/Config.in"
source "$BR2_EXTERNAL_OCTOPRINT_PATH/package/python-watchdog_1_0/Config.in"
source "$BR2_EXTERNAL_OCTOPRINT_PATH/package/python-webassets/Config.in"
source "$BR2_EXTERNAL_OCTOPRINT_PATH/package/python-websocket-client_1_2/Config.in"
source "$BR2_EXTERNAL_OCTOPRINT_PATH/package/python-wrapt_1_13/Config.in"
source "$BR2_EXTERNAL_OCTOPRINT_PATH/package/python-werkzeug_2_0/Config.in"
source "$BR2_EXTERNAL_OCTOPRINT_PATH/package/python-zipstream-ng/Config.in"
source "$BR2_EXTERNAL_OCTOPRINT_PATH/package/python-zeroconf_0_33/Config.in"
source "$BR2_EXTERNAL_OCTOPRINT_PATH/package/python-limits/Config.in"
source "$BR2_EXTERNAL_OCTOPRINT_PATH/package/python-sgmllib3k/Config.in"
source "$BR2_EXTERNAL_OCTOPRINT_PATH/package/python-commonmark/Config.in"
source "$BR2_EXTERNAL_OCTOPRINT_PATH/package/python-deprecated/Config.in"
```

## package/python-charset-normalizer_2_1/Config.in
```kconfig
config BR2_PACKAGE_PYTHON_CHARSET_NORMALIZER_2_1
	bool "python-charset-normalizer_2_1"
	help
	  The Real First Universal Charset Detector. Open, modern and
	  actively maintained alternative to Chardet.

	  https://github.com/ousret/charset_normalizer
```

## package/python-click_8_0/Config.in
```kconfig
config BR2_PACKAGE_PYTHON_CLICK_8_0
	bool "python-click_8_0"
	help
	  A simple wrapper around optparse for powerful command line
	  utilities.

	  https://pypi.python.org/pypi/click
```

## package/python-colorlog_6_4/Config.in
```kconfig
config BR2_PACKAGE_PYTHON_COLORLOG_6_4
	bool "python-colorlog_6_4"
	help
	  Log formatting with colors.

	  https://github.com/borntyping/python-colorlog
```

## package/python-commonmark/Config.in
```kconfig
config BR2_PACKAGE_PYTHON_COMMONMARK
	bool "python-commonmark"
	help
	  commonmark
```

## package/python-deprecated/Config.in
```kconfig
config BR2_PACKAGE_PYTHON_DEPRECATED
	bool "python-deprecated"
	help
	  deprecated
```

## package/python-flask-limiter/Config.in
```kconfig
config BR2_PACKAGE_PYTHON_FLASK_LIMITER
	bool "python-flask-limiter"
	select BR2_PACKAGE_PYTHON_FLASK # runtime
	select BR2_PACKAGE_PYTHON_WEBASSETS # runtime
	help
	  Yep
```

## package/python-flask-login_0_5/Config.in
```kconfig
config BR2_PACKAGE_PYTHON_FLASK_LOGIN_0_5
	bool "python-flask-login_0_5"
	# runtime dependency
	select BR2_PACKAGE_PYTHON_FLASK
	help
	  Flask-Login
```

## package/python-octoprint/Config.in
```kconfig
config BR2_PACKAGE_PYTHON_OCTOPRINT
	bool "python-octoprint"
    select BR2_PACKAGE_PYTHON_ARGON2_CFFI # runtime
	select BR2_PACKAGE_PYTHON_BLINKER # runtime
	select BR2_PACKAGE_PYTHON_CACHELIB # runtime
    select BR2_PACKAGE_PYTHON_CHARSET_NORMALIZER # runtime
	select BR2_PACKAGE_PYTHON_CLICK_8_0 # runtime
	select BR2_PACKAGE_PYTHON_COLORLOG_6_4 # runtime
    select BR2_PACKAGE_PYTHON_COMMONMARK # runtime
    select BR2_PACKAGE_PYTHON_DEPRECATED # runtime
	select BR2_PACKAGE_PYTHON_EMOJI # runtime
    select BR2_PACKAGE_PYTHON_IDNA # runtime
	select BR2_PACKAGE_PYTHON_FILETYPE # runtime
	select BR2_PACKAGE_PYTHON_FEEDPARSER # runtime
	select BR2_PACKAGE_PYTHON_FLASK # runtime
	select BR2_PACKAGE_PYTHON_FLASK_ASSETS # runtime
	select BR2_PACKAGE_PYTHON_FLASK_BABEL # runtime
	select BR2_PACKAGE_PYTHON_FLASK_LIMITER # runtime
    select BR2_PACKAGE_PYTHON_FLASK_LOGIN # runtime
	select BR2_PACKAGE_PYTHON_FROZENDICT # runtime
	select BR2_PACKAGE_PYTHON_FUTURE # runtime
	select BR2_PACKAGE_PYTHON_MARKDOWN # runtime
	select BR2_PACKAGE_PYTHON_NETADDR # runtime
	select BR2_PACKAGE_PYTHON_NETIFACES # runtime
	select BR2_PACKAGE_PYTHON_OCTOPRINT_FILECHECK # runtime
	select BR2_PACKAGE_PYTHON_OCTOPRINT_FIRMWARECHECK # runtime
	select BR2_PACKAGE_PYTHON_OCTOPRINT_PISUPPORT # runtime
    select BR2_PACKAGE_PYTHON_ORDERED_SET # runtime
    select BR2_PACKAGE_PYTHON_PACKAGING # runtime
	select BR2_PACKAGE_PYTHON_PATHVALIDATE # runtime
    select BR2_PACKAGE_PYTHON_PASSLIB # runtime
	select BR2_PACKAGE_PYTHON_PKGINFO # runtime
	select BR2_PACKAGE_PYTHON_PSUTIL # runtime
	select BR2_PACKAGE_PYTHON_PYLRU # runtime
	select BR2_PACKAGE_PYTHON_PYSERIAL # runtime
    select BR2_PACKAGE_PYTHON_PYGMENTS # runtime
	select BR2_PACKAGE_PYTHON_PYYAML_5_4 # runtime
    select BR2_PACKAGE_PYTHON_RICH # runtime
	select BR2_PACKAGE_PYTHON_REQUESTS # runtime
	select BR2_PACKAGE_PYTHON_REGEX # runtime
	select BR2_PACKAGE_PYTHON_SARGE # runtime
	select BR2_PACKAGE_PYTHON_SGMLLIB3K # runtime
	select BR2_PACKAGE_PYTHON_SEMANTIC_VERSION_2_8 # runtime
	select BR2_PACKAGE_PYTHON_SENTRY_SDK_1_5 # runtime
	select BR2_PACKAGE_PYTHON_TORNADO # runtime
    select BR2_PACKAGE_PYTHON_TYPING_EXTENSIONS # runtime
	select BR2_PACKAGE_PYTHON_UNIDECODE # runtime
    select BR2_PACKAGE_PYTHON_URLLIB3 # runtime
	select BR2_PACKAGE_PYTHON_WATCHDOG_1_0 # runtime
	select BR2_PACKAGE_PYTHON_WEBSOCKET_CLIENT_1_2 # runtime
	select BR2_PACKAGE_PYTHON_WERKZEUG_2_0 # runtime
	select BR2_PACKAGE_PYTHON_WRAPT_1_13 # runtime
	select BR2_PACKAGE_PYTHON_ZEROCONF_0_33 # runtime
	select BR2_PACKAGE_PYTHON_ZIPSTREAM_NG # runtime
    select BR2_PACKAGE_PYTHON_LIMITS # runtime
	help
	  The snappy web interface for your 3D printer.

	  https://octoprint.org
```

## package/python-pyyaml_5_4/Config.in
```kconfig
config BR2_PACKAGE_PYTHON_PYYAML_5_4
	bool "python-pyyaml_5_4"
	select BR2_PACKAGE_LIBYAML
	help
	  The PyYAML package contains binding to the libyaml API.

	  http://pyyaml.org/
```

## package/python-semantic-version_2_8/Config.in
```kconfig
config BR2_PACKAGE_PYTHON_SEMANTIC_VERSION_2_8
	bool "python-semantic-version_2_8"
	help
	  Nerp.
```

## package/python-watchdog_1_0/Config.in
```kconfig
config BR2_PACKAGE_PYTHON_WATCHDOG_1_0
	bool "python-watchdog_1_0"
	select BR2_PACKAGE_PYTHON_ARGH # runtime
	select BR2_PACKAGE_PYTHON_PATHTOOLS # runtime
	select BR2_PACKAGE_PYTHON_PYYAML # runtime
	select BR2_PACKAGE_PYTHON_SETUPTOOLS # runtime
	help
	  Python API and shell utilities to monitor file system events.

	  http://github.com/gorakhargosh/watchdog
```

## package/python-websocket-client_1_2/Config.in
```kconfig
config BR2_PACKAGE_PYTHON_WEBSOCKET_CLIENT_1_2
	bool "python-websocket-client_1_2"
	select BR2_PACKAGE_PYTHON_SIX # runtime
	select BR2_PACKAGE_PYTHON3_SSL # runtime
	help
	  WebSocket client for python. hybi13 is supported.

	  https://github.com/websocket-client/websocket-client.git
```

## package/python-werkzeug_2_0/Config.in
```kconfig
config BR2_PACKAGE_PYTHON_WERKZEUG_2_0
	bool "python-werkzeug_2_0"
	select BR2_PACKAGE_PYTHON3_ZLIB # runtime
	help
	  Werkzeug is a WSGI utility library for Python. It's widely
	  used and BSD licensed.

	  http://werkzeug.pocoo.org/
```

## package/python-wrapt_1_13/Config.in
```kconfig
config BR2_PACKAGE_PYTHON_WRAPT_1_13
	bool "python-wrapt"
	help
	  Module for decorators, wrappers and monkey patching.

	  https://github.com/GrahamDumpleton/wrapt
```

## package/python-zeroconf_0_33/Config.in
```kconfig
config BR2_PACKAGE_PYTHON_ZEROCONF_0_33
	bool "python-zeroconf_0_33"
	select BR2_PACKAGE_PYTHON_IFADDR # runtime
	help
	  Pure Python Multicast DNS Service Discovery Library
	  (Bonjour/Avahi compatible).

	  https://github.com/jstasiak/python-zeroconf
```
